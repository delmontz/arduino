/*******************************************************************************
*  skMC24xxx - Microchip I2C EEPROM(24xxxファミリ)関数ライブラリ               *
*                                                                              *
*    skMC24xxx - EEPROM関数ライブラリを生成する時の初期化処理                  *
*    Write     - EEPROMに指定個数だけデータを書き込む処理                      *
*    Read      - EEPROMから指定個数だけデータを読み出す処理                    *
*                                                                              *
* ============================================================================ *
*   VERSION  DATE        BY             CHANGE/COMMENT                         *
* ---------------------------------------------------------------------------- *
*   1.00     2012-01-25  きむ茶工房     Create                                 *
*   1.10     2012-09-14  きむ茶工房     ArduinoIDE 1.0.1に対応して変更         *
*******************************************************************************/
#include <Wire.h>
#include "arduino.h"
#include "skMC24xxx.h"

int skMC24xxx::slave_adrs ;              // スレーブ(EEPROM)のアドレス


/*******************************************************************************
*  skMC24xxx(A0,A1,A2)                                                         *
*    EEPROM関数ライブラリを生成する時の初期化処理(コンストラクタ)              *
*    A0/A1/A2 : EEPROMの1(A0),2(A1),3(A2)端子の情報を設定する(High=1 Low=0)    *
*******************************************************************************/
skMC24xxx::skMC24xxx(int A0,int A1,int A2)
{
     Wire.begin() ;                     // Ｉ２Ｃの初期化、マスターとする

     slave_adrs = CTLCODE | (A2<<2) | (A1<<1) | A0 ;
}
/*******************************************************************************
*  ans = Read(adrs,*data,num)                                                  *
*    EEPROMから指定個数だけデータを読み出す処理                                *
*                                                                              *
*    adrs : 読み出し開始のデータアドレス位置を指定します                       *
*    *data: 読み出したデータを保存する為の配列変数を指定します                 *
*    num  : 読み出すデータの個数を指定します(この個数分だけ配列変数は確保する) *
*    ans  : 戻り値、0=正常終了　それ以外I2C通信エラー下記                      *
*                   1=送ろうとしたデータが送信バッファのサイズを超えた         *
*                   2=スレーブ・アドレスを送信し、NACKを受信した               *
*                   3=データ・バイトを送信し、NACKを受信した                   *
*                   4=その他のエラー                                           *
*                   5=データ受信エラー                                         *
*******************************************************************************/
int skMC24xxx::Read(int adrs,char *data,int num)
{
     byte x ;
     int i , ans ;

     Wire.beginTransmission(slave_adrs) ;         // 通信の開始処理
     x = (byte)(adrs >> 8) ;
     Wire.write(x) ;                               // メモリのHigh側アドレスを指定する
     x = (byte)(adrs & 0x00ff) ;
     Wire.write(x) ;                               // メモリのLow 側アドレスを指定する
     ans = Wire.endTransmission() ;               // データの送信と通信の終了処理
     if (ans == 0) {
          ans = Wire.requestFrom(slave_adrs,num) ;// データを受信の開始処理
          if (ans == num) {
               for (i=0 ; i<num ; i++ ) {
                    *data = Wire.read() ;      // 指定個数分読み出す
                    data++ ;
               }
               ans = 0 ;
          } else ans = 5 ;
     }
     return ans ;
}
/*******************************************************************************
*  ans = Write(adrs,*data,num)                                                 *
*    EEPROMに指定個数だけデータを書き込む処理                                  *
*                                                                              *
*    adrs : 書き込み開始のデータアドレス位置を指定します                       *
*    *data: 書き込むデータを保存した配列変数を指定します                       *
*           デバイスのページサイズ以上は連続書き込みは出来ません               *
*           24xx32/64は32byte   24xx128/256は64byte  24xx512は128byte          *
*    num  : 書き込むデータの個数を指定します                                   *
*    ans  : 戻り値、0=正常終了　それ以外I2C通信エラー下記                      *
*                   1=送ろうとしたデータが送信バッファのサイズを超えた         *
*                   2=スレーブ・アドレスを送信し、NACKを受信した               *
*                   3=データ・バイトを送信し、NACKを受信した                   *
*                   4=その他のエラー                                           *
*                   5=データ受信エラー                                         *
*******************************************************************************/
int skMC24xxx::Write(int adrs,char *data,int num)
{
     byte x ;
     int i , ans ;

     Wire.beginTransmission(slave_adrs) ;    // 通信の開始処理
     x = (byte)(adrs >> 8) ;
     Wire.write(x) ;                          // メモリのHigh側アドレスを指定する
     x = (byte)(adrs & 0x00ff) ;
     Wire.write(x) ;                          // メモリのLow 側アドレスを指定する
     for (i=0 ; i<num ; i++ ) {
          Wire.write(*data) ;                 // 指定個数分書き込む
          data++ ;
     }
     ans = Wire.endTransmission() ;          // データの送信と通信の終了処理
     return ans ;
}
