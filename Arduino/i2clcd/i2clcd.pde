/**************************************************************
 *　Wire経由GLCD漢字表示                                      *
 *    - Receiver -                                            *
 *    Version:   1.0 - 2010/11                                *
 **************************************************************/
#include "ks0108.h"              // ※EN Bit 18を3に変更
#include "ks0108w.h"
#include <Wire.h>

#include <Arial14.h>             // proportional font
#include <SystemFont5x7.h>       // system font

#define maxBitmap 1024+2         // 
uint8_t ready = 1;               // 1;準備中　0;準備完了
int ledPin =  13;                // 処理中表示
//aaaaaaaaaaaaaaaaaaaaaaaaaaaaaaaaaaaaaaaaaaaaaaaaaaaaaaaaaaaaaaaaaaaaaaaaaaaaaaaaaa
int RS_pin ;                  // RS(register select)の接続ピン番号を保存
int RW_pin ;                  // RW(read/write)の接続ピン番号を保存
int E_pin ;                   // E (enable signal)の接続ピン番号を保存
int CS1_pin ;                 // CS1(selection IC1)の接続ピン番号を保存
int CS2_pin ;                 // CS2(selection IC2)の接続ピン番号を保存
int DATA_pins[8] ;            // DB0-7(data bit)の接続ピン番号を保存
int SetPg ;
int SetCol ;
/*******************************************************************************
*  Pins_Start(rst,rs,rw,enable,cs1,cs2,d0,d1,d2,d3,d4,d5,d6,d7)                 *
*    グラフィックLCDモジュールと接続するピンの初期化処理                       *
*                                                                              *
*    rst    : RST(reset signal)信号と接続しているピン番号を指定                *
*    rs     : RS(register select)信号と接続しているピン番号を指定              *
*    rw     : RW(read/write)信号と接続しているピン番号を指定                   *
*    enable : E (enable signal)信号と接続しているピン番号を指定                *
*    cs1    : CS1(selection IC1)信号と接続しているピン番号を指定               *
*    cs2    : CS2(selection IC2)信号と接続しているピン番号を指定               *
*    d0-d7  : DB4-7(data bit)信号と接続しているピン番号を指定                  *
*******************************************************************************/
void Pins_Init(int rst,int rs,int rw,int enable,int cs1,int cs2,
               int d0,int d1,int d2,int d3,int d4,int d5,int d6,int d7)
{
     // データピンの番号をセット
     DATA_pins[0] = d0 ;
     DATA_pins[1] = d1 ;
     DATA_pins[2] = d2 ;
     DATA_pins[3] = d3 ;
     DATA_pins[4] = d4 ;
     DATA_pins[5] = d5 ;
     DATA_pins[6] = d6 ;
     DATA_pins[7] = d7 ;
     // 制御ピンの番号をセット
     RS_pin  = rs ;
     RW_pin  = rw ;
     E_pin   = enable ;
     CS1_pin = cs1 ;
     CS2_pin = cs2 ;
     // 指定の制御ピンをデジタル出力に設定
     pinMode(RS_pin, OUTPUT) ;
     pinMode(RW_pin, OUTPUT) ;
     pinMode(E_pin, OUTPUT) ;
     pinMode(CS1_pin, OUTPUT) ;
     pinMode(CS2_pin, OUTPUT) ;
     // 指定のデータピンをデジタル出力に設定
     for (int i = 0; i < 8; i++) pinMode(DATA_pins[i], OUTPUT) ;
     // 信号線をLOWに設定して置きます
     digitalWrite(RS_pin, LOW);
     digitalWrite(RW_pin, LOW);
     digitalWrite(E_pin, LOW);
     digitalWrite(CS1_pin, LOW);
     digitalWrite(CS2_pin, LOW);
     // グラフィックLCDモジュールのリセットを解除する
     pinMode(rst, OUTPUT) ;
     digitalWrite(rst, HIGH);
}
/*******************************************************************************
*  GLCD_Init()                                                                 *
*    グラフィックLCDモジュールに初期化情報を発行する処理                       *
*******************************************************************************/
void GLCD_Start()
{
     // LCD電源がONしてから30msほどウエイトするみたいなので入れておく
     delay(30) ;
     // 左側ディスプレイのチップ(IC1)を初期化する
     SelectIC(1) ;		     // IC1を選択
     command(0xC0,LOW) ;		// Display start lineのコマンドを発行する
     command(0x3F,LOW) ;		// Display Onのコマンドを発行する
     // 右側ディスプレイのチップ(IC2)を初期化する
     SelectIC(2) ;            // IC2を選択
     command(0xC0,LOW) ;		// Display start lineのコマンドを発行する
     command(0x3F,LOW) ;		// Display Onのコマンドを発行する
}
/*******************************************************************************
*  SelectIC(value)                                                             *
*    ディスプレイのチップ(IC)を選択する処理                                    *
*                                                                              *
*    value : 1=左側ディスプレイのチップ(IC1)  2=右側ディスプレイのチップ(IC2)  *
*******************************************************************************/
void SelectIC(int value)
{
     if (value==1) {
          // 左側ディスプレイのチップ(IC1)を選択する
          digitalWrite(CS1_pin, HIGH);
          digitalWrite(CS2_pin, LOW);
     } else {
          // 右側ディスプレイのチップ(IC2)を選択する
          digitalWrite(CS2_pin, HIGH);
          digitalWrite(CS1_pin, LOW);
     }
}
/*******************************************************************************
*  SetPage(value)                                                              *
*    ページの設定を行うコマンドを発行する処理                                  *
*                                                                              *
*    value : ページ０～７を選択する(縦アドレス)                                *
*******************************************************************************/
void SetPage(int value)
{
     command(0xB8|(value&0x07),LOW) ;
}
/*******************************************************************************
*  SetAddress(value)                                                           *
*    カラムアドレスの設定を行うコマンドを発行する処理                          *
*                                                                              *
*    value : ０～６３を選択する(横アドレス)                                    *
*******************************************************************************/
void SetAddress(int value)
{
     command(0x40|(value&0x3F),LOW) ;
}
/*******************************************************************************
*  ans = ReadData()                                                            *
*    現在表示されているデータの内容を読込むコマンドを発行する処理              *
*                                                                              *
*    ans : ８ビットの読込んだデータを返す                                      *
*******************************************************************************/
unsigned int ReadData()
{
     unsigned int ans , i ;

     // データピンをデジタル入力に設定
     for (i = 0; i < 8; i++) pinMode(DATA_pins[i], INPUT) ;
     // グラフィックLCDモジュールから読込みモードに設定する
     digitalWrite(RW_pin, HIGH);
     digitalWrite(RS_pin, HIGH) ;
     // データピンからデータを読込む
     digitalWrite(E_pin, HIGH) ;
     digitalWrite(E_pin, LOW) ;
     ans = 0 ;
     digitalWrite(E_pin, HIGH) ;
     for (i = 0; i < 8; i++) {
          ans = ans | (digitalRead(DATA_pins[i]) << i);
     }
     digitalWrite(E_pin, LOW) ;
     // モードを書込みに設定しデータピンをデジタル出力に戻す
     digitalWrite(RW_pin, LOW);
     for (i = 0; i < 8; i++) pinMode(DATA_pins[i], OUTPUT) ;

     return( ans ) ;
}
/*******************************************************************************
*  WriteData(value)                                                            *
*    表示するデータを書込むコマンドを発行する処理                              *
*    書込んだ後、カラムアドレスは自動的に次のアドレスへ移動します。            *
*                                                                              *
*    value : ８ビットのデータを指定する                                        *
*******************************************************************************/
void WriteData(int value)
{
     command(value,HIGH) ;
}
// グラフィックLCDモジュールコマンドを発行する処理
void command(int value,int mode)
{
     int i ;

     // RSの制御信号線をセットします
     digitalWrite(RS_pin, mode) ;
     // D0-D7のデータ線にセットします
     for (i = 0; i < 8; i++) {
          digitalWrite(DATA_pins[i], (value >> i) & 0x01) ;
     }
     // Eの制御信号線をセットします
     digitalWrite(E_pin, HIGH) ;
     digitalWrite(E_pin, LOW) ;
}
//aaaaaaaaaaaaaaaaaaaaaaaaaaaaaaaaaaaaaaaaaaaaaaaaaaaaaaaaaaaaaaaaaaaaaaaaaaaaaaaaaa
/**************************************************************
 * 美咲フォント                                               *
 **************************************************************/
static prog_uint8_t font_E2[][10] PROGMEM = {
  {0x80,0x90, 0x00,0x00,0x08,0x08,0x08,0x00,0x00,0x00,},	// 【 ‐ 】
  {0x80,0x94, 0x08,0x08,0x08,0x08,0x08,0x08,0x08,0x08,},	// 【 ― 】
  {0x80,0x96, 0x00,0x00,0x7f,0x00,0x7f,0x00,0x00,0x00,},	// 【 ∥ 】
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  {0x99,0xaf, 0x00,0x28,0x7e,0x14,0x14,0x3f,0x0a,0x00,}         // 【 ♯ 】
};
static prog_uint8_t font_E3[][10] PROGMEM = {
  {0x80,0x80, 0x00,0x00,0x00,0x00,0x00,0x00,0x00,0x00,},	// 【 　 】
  {0x80,0x81, 0x20,0x40,0x00,0x00,0x00,0x00,0x00,0x00,},	// 【 、 】
  {0x80,0x82, 0x20,0x50,0x20,0x00,0x00,0x00,0x00,0x00,},	// 【 。 】
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  {0x8F,0x8D, 0x7f,0x08,0x77,0x00,0x7f,0x08,0x77,0x00,},	// 【 ㏍ 】
};
static prog_uint8_t font_E4[][10] PROGMEM = {
  {0xb8,0x80, 0x08,0x08,0x08,0x08,0x08,0x0c,0x08,0x00,},	// 【 一 】
  {0xb8,0x81, 0x01,0x01,0x41,0x7f,0x01,0x01,0x01,0x00,},	// 【 丁 】
  {0xb8,0x83, 0x08,0x08,0x3f,0x48,0x44,0x44,0x64,0x00,},	// 【 七 】
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  {0xbf,0xb5, 0x04,0x7e,0x2b,0x7a,0x5f,0x2a,0x52,0x00,}  	// 【 俵 】
};
static prog_uint8_t font_E5[][10] PROGMEM = {
  {0x80,0x89, 0x44,0x24,0x1e,0x6d,0x6e,0x64,0x04,0x00,},	// 【 倉 】
  {0x80,0x8b, 0x04,0x7e,0x7f,0x75,0x6f,0x75,0x7f,0x00,},	// 【 個 】
  {0x80,0x8d, 0x04,0x7e,0x0b,0x6e,0x6b,0x6e,0x0a,0x00,},	// 【 倍 】
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  {0xbf,0xb5, 0x64,0x24,0x4a,0x4d,0x5e,0x04,0x64,0x00,}	        // 【 念 】
};
static prog_uint8_t font_E6[][10] PROGMEM = {
  {0x80,0x9d, 0x60,0x3f,0x55,0x5f,0x75,0x1f,0x60,0x00,},	// 【 思 】
  {0x80,0xa5, 0x62,0x36,0x55,0x55,0x77,0x1c,0x60,0x00,},	// 【 急 】
  {0x80,0xa7, 0x06,0x7f,0x44,0x53,0x7f,0x52,0x42,0x00,},	// 【 性 】
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  {0xbf,0x80, 0x75,0x26,0x5f,0x36,0x5c,0x23,0x5e,0x00,}	        // 【 激 】
};
static prog_uint8_t font_E7[][10] PROGMEM = {
  {0x81,0xab, 0x40,0x4c,0x20,0x1f,0x28,0x44,0x40,0x00,},	// 【 火 】
  {0x81,0xaf, 0x4c,0x3f,0x24,0x01,0x41,0x7f,0x01,0x00,},	// 【 灯 】
  {0x81,0xb0, 0x40,0x3f,0x4d,0x21,0x1f,0x29,0x45,0x00,},	// 【 灰 】
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  {0xbf,0x92, 0x09,0x6b,0x75,0x6f,0x6b,0x65,0x0f,0x00,}	        // 【 習 】
};
static prog_uint8_t font_E8[][10] PROGMEM = {
  {0x80,0x81, 0x28,0x1a,0x0a,0x7f,0x5e,0x5a,0x49,0x00,},	// 【 老 】
  {0x80,0x83, 0x28,0x2a,0x1a,0x3f,0x2e,0x2a,0x69,0x00,},	// 【 考 】
  {0x80,0x85, 0x28,0x2a,0x1a,0x6f,0x6e,0x6a,0x09,0x00,},	// 【 者 】
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  {0xbf,0xbd, 0x49,0x3a,0x40,0x7e,0x57,0x56,0x76,0x00,}	        // 【 追 】
};
static prog_uint8_t font_E9[][10] PROGMEM = {
  {0x80,0x80, 0x49,0x3a,0x40,0x7f,0x55,0x75,0x6f,0x00,},	// 【 退 】
  {0x80,0x81, 0x49,0x38,0x62,0x6b,0x5e,0x6b,0x62,0x00,},	// 【 送 】
  {0x80,0x86, 0x49,0x38,0x5a,0x73,0x5e,0x53,0x5a,0x00,},	// 【 逆 】
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  {0xbc,0xbb, 0x20,0x78,0x2e,0x3b,0x6e,0x38,0x20,0x00,}	        // 【 鼻 】
};
static prog_uint8_t font_EF[][10] PROGMEM = {
  {0xbc,0x81, 0x00,0x00,0x00,0x5f,0x00,0x00,0x00,0x00,},	// 【 ！ 】
  {0xbc,0x83, 0x20,0x62,0x3e,0x63,0x3e,0x23,0x02,0x00,},	// 【 ＃ 】
  {0xbc,0x84, 0x00,0x24,0x2a,0x7a,0x2f,0x2a,0x12,0x00,},	// 【 ＄ 】
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  {0xbf,0xa5, 0x00,0x2b,0x2c,0x78,0x2c,0x2b,0x00,0x00,}   	// 【 ￥ 】
};
/**********************************
 * 初期化                         *
 **********************************/ 
void setup(){
  Pins_Init(0,4,1,5,2,3,6,7,8,9,10,11,12,13);
  GLCD_Start();
  GLCD.Init(NON_INVERTED);        // initialise the library, non inverted writes pixels onto a clear screen
  GLCD.ClearScreen();  
  GLCD.SelectFont(System5x7);     // switch to fixed width system font
  Wire.begin(i2cAdr);             // join i2c bus with address
  Wire.onReceive(receiveEvent);   // register event
  Wire.onRequest (requestEvent);  // register event 
  ready = 0;                      // 準備完了
//   Serial.begin(9600);            // **************************************
} 
void kanji(uint8_t* p2);          //
/**********************************
 * メイン・ループ                 *
 **********************************/
void loop(){
  delay(100);
}
/**********************************
 * 準備完了確認が来ました　       *
 **********************************/
void requestEvent (){
  Wire.send(ready);               // 準備状況通知
} 
/**********************************
 * データが送られてきました       *
 **********************************/
int pos1, pos2;
uint8_t rData1[10];                 // パラメータ格納領域
uint8_t rData2[maxBitmap+1];        // データ格納領域
void receiveEvent(int howMany){
  ready = 1;                        // データ処理開始
  while(1 < Wire.available()){      // loop through all but the last 
    uint8_t c1 = Wire.receive();    // receive byte
    uint8_t c2 = Wire.receive();    // receive byte 
    digitalWrite(ledPin, HIGH);     // 
    if (c1 == W_Cmd) {              // *Start + コマンド
      pos1 = 0; pos2 = 0;
      rData1[pos1++] = c2;
    } else if (c1 == W_Para) {      // *パラメータ
      rData1[pos1++] = c2;
    } else if (c1 == W_Data) {      // *データ
      if(pos2 < maxBitmap) {
        rData2[pos2++] = c2;
      }
    } else if (c1 == W_End ) {      // *End
        analysis(rData1, rData2);
    }
    digitalWrite(ledPin, LOW);      //   
  }
  ready = 0;                        // データ処理終了
}
/**********************************
 * GLCD.Puts((char*)p2); 漢字処理 *
 *   1. void buildMapCMP()
 *   2. void kanji()
 **********************************/
 uint8_t fBitMap[8+2] = {8, 8};
 static prog_uint8_t fErrMap[] = {0x60,0x40,0x40,0x40,0x40,0x40,0x60,0x00}; // 該当コード無し　※要
// *** 1. void buildMapCMP() ***
 void buildMapCMP(prog_uint8_t buf[][10], int s, uint8_t b1, uint8_t b2){                                      //***********************
  for(int i = 0; i < s; i++){
    if((pgm_read_byte_near(&buf[i][0]) == b1) && (pgm_read_byte_near(&buf[i][1]) == b2)){
      for(int j = 0; j < 8 ; j++){
        fBitMap[j+2] = pgm_read_byte_near(&buf[i][j+2]);
      }
      return;
    }
  }
  for(int i = 0; i < sizeof(fErrMap); i++)fBitMap[i+2] = fErrMap[i];
}
// *** 2. void kanji() ***
 void kanji(uint8_t* p2){
   int x = GLCD.Coord.x;
   uint8_t char1, char2, char3;
   while(char1 = *p2++){
     if ((0xE2 <= char1) && (char1 <= 0xEF)){   // Unicode "E2xxxx"～"E9xxxx"
       char2 = *p2++; char3 = *p2++;
       switch(char1 - 0xE2) {
         case  0: buildMapCMP(font_E2, sizeof(font_E2) / sizeof(font_E2[0]), char2, char3); break;
         case  1: buildMapCMP(font_E3, sizeof(font_E3) / sizeof(font_E3[0]), char2, char3); break;
         case  2: buildMapCMP(font_E4, sizeof(font_E4) / sizeof(font_E4[0]), char2, char3); break;
         case  3: buildMapCMP(font_E5, sizeof(font_E5) / sizeof(font_E5[0]), char2, char3); break;       
         case  4: buildMapCMP(font_E6, sizeof(font_E6) / sizeof(font_E6[0]), char2, char3); break;
         case  5: buildMapCMP(font_E7, sizeof(font_E7) / sizeof(font_E7[0]), char2, char3); break;
         case  6: buildMapCMP(font_E8, sizeof(font_E8) / sizeof(font_E8[0]), char2, char3); break;
         case  7: buildMapCMP(font_E9, sizeof(font_E9) / sizeof(font_E9[0]), char2, char3); break;
         case 13: buildMapCMP(font_EF, sizeof(font_EF) / sizeof(font_EF[0]), char2, char3); break;
         default:for(int i = 2; i < sizeof(fErrMap); i++)fBitMap[i] = fErrMap[i];        
        }
        DBsimulation(fBitMap, GLCD.Coord.x, GLCD.Coord.y, BLACK);
     } else {
       if(char1 == '\n') {
         GLCD.GotoXY(x, GLCD.Coord.y+8);
       } else {
         GLCD.PutChar(char1);                // 
       }
     }
   }
 }
/**********************************
 * DrawBitmapをシミュレーション   *
 **********************************/
void DBsimulation(uint8_t* p2, uint8_t x, uint8_t y, uint8_t color){
  uint8_t width, height;
  uint8_t i, j, k;
  int bitmap = 0;
  width = p2[bitmap++]; 
  height = p2[bitmap++]; 
  for(j = 0; j < height / 8; j++) {
    for(i = 0; i < width; i++) {
      uint8_t displayData = p2[bitmap++];
      for(k = 0; k < 8; k++) {
        uint8_t displayBit = displayData & 0x01;
        if(displayBit == 1){
          GLCD.SetDot(x + i, y + (j*8 + k), color);   
        } else {
          GLCD.SetDot(x + i, y + (j*8) + k, ~color);
        }      
        displayData = displayData >> 1;
      }
    }
  }
}
/**************************************************************
 * 受信データの解析                                           *
 **************************************************************/
void analysis(uint8_t p1[], uint8_t p2[]){
  switch (p1[0]) {
    case C_ClearPage:               // *ClearPage コマンド
      GLCD.ClearPage(p1[1], p1[2]);
      break;
    case C_ClearScreen:             // *ClearScreen コマンド
      GLCD.ClearScreen(p1[1]);
      break;
    case C_CursorTo:                // *CursorTo コマンド
      GLCD.CursorTo(p1[1], p1[2]);
      break;
    case C_DrawBitmap:              // *DrawBitmap コマンド 
      DBsimulation(p2, p1[1], p1[2], p1[3]); // DrawBitmapをシミュレーション
      break;  
    case C_DrawLine:                // *DrawLine コマンド
      GLCD.DrawLine(p1[1], p1[2], p1[3], p1[4], p1[5]);  
      break;
    case C_DrawRect:                // *DrawRect コマンド
      GLCD.DrawRect(p1[1], p1[2], p1[3], p1[4], p1[5]);     
      break;      
    case C_DrawRoundRect:           // *DrawRoundRect コマンド
      GLCD.DrawRoundRect(p1[1], p1[2], p1[3], p1[4], p1[5], p1[6]);
      break;
    case C_FillRect:                // *FillRect コマンド
      GLCD.FillRect(p1[1], p1[2], p1[3], p1[4], p1[5]);
      break;      
    case C_GotoXY:                  // *GotoXY コマンド
      GLCD.GotoXY(p1[1], p1[2]);
      break;
    case C_Init:                    // *Init コマンド  z  
      Pins_Init(0,4,1,5,2,3,6,7,8,9,10,11,12,13);
      GLCD_Start();  
      GLCD.Init(p1[1]);             //********************************
      GLCD.ClearScreen();  
      GLCD.SelectFont(System5x7);   // switch to fixed width system font
      break;
    case C_InvertRect:              // *InvertRect コマンド
      GLCD.InvertRect(p1[1], p1[2], p1[3], p1[4]);
      break;
    case C_PrintNumber:             // *PrintNumber コマンド    
      GLCD.PrintNumber((p1[1] << 8) + p1[2]);       
      break;      
    case C_Puts:                    // *Puts コマンド
      kanji(p2);                    // 要漢字処理
      break;
    case C_Puts_P:                  // *Puts_P コマンド
      kanji(p2);                    // 要漢字処理
      break;     
    case C_PutChar:                 // *PutChar コマンド
      GLCD.PutChar(p1[1]);    
      break; 
    case C_SelectFont:              // *SelectFont コマンド
      for(int i = 0; i < 6; i++){
        if(pgm_read_byte_near(Arial_14 + i) != p1[i+1]) break;
        if(i = 5) GLCD.SelectFont(Arial_14);
      }
      for(int i = 0; i < 6; i++){
        if(pgm_read_byte_near(System5x7 + i) != p1[i+1]) break;
        if(i = 5) GLCD.SelectFont(System5x7);
      }      
      break;
    case C_SetDot:                 // *SetDot コマンド
      GLCD.SetDot(p1[1], p1[2], p1[3]);    
      break;  
    case C_SetInverted:            // *SetInverted コマンド  
      GLCD.SetInverted(p1[1]); 
      break;  
  } 
}
// End

